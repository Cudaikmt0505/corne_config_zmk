## boards/shields/corne_left/Kconfig.defconfig
```kconfig
# SPDX-License-Identifier: MIT

if SHIELD_CORNE_LEFT

config ZMK_MATRIX_ROWS
    int
    default 4

config ZMK_MATRIX_COLS
    int
    default 6

config ZMK_MATRIX_ROW_PINS
    string
    default "D2 D3 D4 D5"

config ZMK_MATRIX_COL_PINS
    string
    default "D20 D21 D9 D8 D7 D6"

config ZMK_SPLIT_ROLE
    string
    default "left"

endif
```

## boards/shields/corne_left/Kconfig.shield
```kconfig
# SPDX-License-Identifier: MIT

config SHIELD_CORNE_LEFT
    bool "Shield: corne_left"
    select ZMK_KEYBOARD
```

## boards/shields/corne_right/Kconfig.shield
```kconfig
# SPDX-License-Identifier: MIT

config SHIELD_CORNE_RIGHT
    bool "Shield: corne_right"
    select ZMK_KEYBOARD
```
